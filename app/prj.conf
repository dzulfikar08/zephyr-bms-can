## CMakeLists.txt
```
# SPDX-License-Identifier: MIT
cmake_minimum_required(VERSION 3.20.0)

# Pulls in Zephyr's build system (ZEPHYR_BASE from scripts/env.sh).
find_package(Zephyr REQUIRED HINTS $ENV{ZEPHYR_BASE})
project(zephyr_bms LANGUAGES C)

target_sources(app PRIVATE src/main.c src/pack.c)
```

## prj.conf
```kconfig
# Kconfig for the application. Each line switches on a Zephyr subsystem or
# sets an option; the board's defaults come from nucleo_h743zi_defconfig.

# CAN driver (STM32H7 FDCAN, a Bosch M_CAN core) and its API
CONFIG_CAN=y

# Logging over the console UART (usart3 on this board)
CONFIG_LOG=y
CONFIG_LOG_MODE_DEFERRED=y
CONFIG_LOG_BACKEND_UART=y

# Task watchdog, falling back to the STM32 independent watchdog (IWDG)
CONFIG_WATCHDOG=y
CONFIG_TASK_WDT=y
CONFIG_TASK_WDT_HW_FALLBACK=y
CONFIG_TASK_WDT_CHANNELS=4

# sys_reboot() from the watchdog callback
CONFIG_REBOOT=y

# Thread names show up in logs and in the watchdog message
CONFIG_THREAD_NAME=y

# The pack model uses float; the Cortex-M7 has a hardware FPU
CONFIG_FPU=y

# Catch stack overflows in our threads (MPU guard)
CONFIG_HW_STACK_PROTECTION=y

# The hardware watchdog window is MIN_TIMEOUT + HW_FALLBACK_DELAY. The STM32
# LSI clock that drives the IWDG is only roughly 32 kHz, so leave a margin.
CONFIG_TASK_WDT_MIN_TIMEOUT=100
CONFIG_TASK_WDT_HW_FALLBACK_DELAY=200
```

## boards/nucleo_h743zi.overlay
```dts
/*
 * Devicetree overlay, applied automatically on top of the board's .dts
 * because its name matches the board (app/boards/<board>.overlay).
 *
 * The edge controller (edge-linux-can, can-bitrate@can0) runs its bus at
 * 500 kbit/s; every node on a real CAN bus must use the same bitrate.
 * Without this, Zephyr's default (CONFIG_CAN_DEFAULT_BITRATE) is 125 kbit/s.
 * In the emulators this does not matter (Renode, QEMU and vcan ignore bit
 * timing), but on a real bus it is the difference between working and
 * error frames.
 */
&fdcan1 {
	bitrate = <500000>;
	sample-point = <875>;
};
```

## src/main.c
```c
/*
 * zephyr-bms: a fake battery management system that talks CAN.
 *
 * Who does what:
 *
 *   tick_timer (k_timer, 100 ms) ──EVT_TICK──┐
 *   CAN RX filter callbacks (ISR) ─EVT_CMD───┼─► evt_q (k_msgq) ─► bms thread
 *                                 └EVT_EDGE──┘                       │ pack model,
 *                                                                    │ state machine
 *                                                                    ▼
 *                                         tx_q (k_msgq of can_frame) ─► can_tx thread ─► can_send()
 *
 * Both threads have a task watchdog channel; the task watchdog in turn feeds
 * the STM32 independent watchdog (IWDG), so a stuck thread resets the chip.
 *
 * Frame layouts are in dbc/zephyr-bms.dbc.
 */
#include <zephyr/kernel.h>
#include <zephyr/device.h>
#include <zephyr/drivers/can.h>
#include <zephyr/logging/log.h>
#include <zephyr/logging/log_ctrl.h>
#include <zephyr/sys/byteorder.h>
#include <zephyr/sys/reboot.h>
#include <zephyr/task_wdt/task_wdt.h>

#include "pack.h"

LOG_MODULE_REGISTER(bms, LOG_LEVEL_INF);

/* CAN identifiers (11-bit). 0x100/0x101/0x321 belong to edge-linux-can. */
#define ID_STATUS       0x410
#define ID_CELL_SUMMARY 0x411
#define ID_TEMPERATURES 0x412
#define ID_CELL_VOLTS   0x413
#define ID_HEARTBEAT    0x41F
#define ID_COMMAND      0x420
#define ID_COMMAND_ACK  0x421
#define ID_FAULT        0x430
#define ID_EDGE_HB      0x101 /* edge-linux-can can-demo heartbeat on can0 */

#define TICK_MS          100
#define EDGE_TIMEOUT_MS  3000
#define BMS_WDT_MS       1000
#define TX_WDT_MS        2000

enum evt_type { EVT_TICK, EVT_CMD, EVT_EDGE };

struct bms_evt {
	uint8_t type;
	uint8_t cmd;
	uint8_t token;
};

K_MSGQ_DEFINE(evt_q, sizeof(struct bms_evt), 32, 4);
K_MSGQ_DEFINE(tx_q, sizeof(struct can_frame), 32, 4);

static const struct device *const can_dev = DEVICE_DT_GET(DT_CHOSEN(zephyr_canbus));
static const struct device *const hw_wdt = DEVICE_DT_GET_OR_NULL(DT_ALIAS(watchdog0));

static atomic_t dropped_evts;
static atomic_t dropped_tx;

/* ---- producers: timer and CAN receive (interrupt context, must not block) ---- */

static void post(const struct bms_evt *e)
{
	if (k_msgq_put(&evt_q, e, K_NO_WAIT) != 0) {
		atomic_inc(&dropped_evts);
	}
}

static void tick_fn(struct k_timer *t)
{
	ARG_UNUSED(t);
	post(&(struct bms_evt){.type = EVT_TICK});
}

K_TIMER_DEFINE(tick_timer, tick_fn, NULL);

static void can_rx_cb(const struct device *dev, struct can_frame *f, void *user)
{
	ARG_UNUSED(dev);
	ARG_UNUSED(user);
	if (f->id == ID_COMMAND && f->dlc >= 1) {
		post(&(struct bms_evt){.type = EVT_CMD, .cmd = f->data[0],
				       .token = f->dlc >= 2 ? f->data[1] : 0});
	} else if (f->id == ID_EDGE_HB) {
		post(&(struct bms_evt){.type = EVT_EDGE});
	}
}

static void can_state_cb(const struct device *dev, enum can_state state,
			 struct can_bus_err_cnt err, void *user)
{
	ARG_UNUSED(dev);
	ARG_UNUSED(user);
	LOG_WRN("CAN controller state %d (tx_err %u, rx_err %u)", state, err.tx_err_cnt,
		err.rx_err_cnt);
}

/* ---- frame building ---- */

static void queue_frame(uint32_t id, const uint8_t *data, uint8_t len)
{
	struct can_frame f = {.id = id, .dlc = len};

	memcpy(f.data, data, len);
	if (k_msgq_put(&tx_q, &f, K_NO_WAIT) != 0) {
		atomic_inc(&dropped_tx);
	}
}

static void send_status(const struct pack *p, bool edge_alive, uint8_t counter)
{
	uint8_t d[8];
	int16_t current_da = (int16_t)(p->current_a * 10.0f);
	int soc_half = (int)(p->soc * 200.0f + 0.5f);

	sys_put_le16((uint16_t)(pack_voltage_mv(p) / 10), &d[0]);
	sys_put_le16((uint16_t)current_da, &d[2]);
	d[4] = (uint8_t)CLAMP(soc_half, 0, 200);
	d[5] = (p->state & 0x0F) | (p->contactor << 4) | (p->balancing << 5) |
	       ((p->faults != 0) << 6) | (edge_alive << 7);
	d[6] = p->faults;
	d[7] = counter;
	queue_frame(ID_STATUS, d, 8);
}

static void send_cell_summary(const struct pack *p)
{
	uint8_t d[7];
	int lo, hi;

	pack_cell_min_max(p, &lo, &hi);
	sys_put_le16(p->cell_mv[lo], &d[0]);
	sys_put_le16(p->cell_mv[hi], &d[2]);
	d[4] = lo + 1;
	d[5] = hi + 1;
	d[6] = p->balancing_mask;
	queue_frame(ID_CELL_SUMMARY, d, 7);
}

static uint8_t temp_byte(float c)
{
	return (uint8_t)CLAMP((int)(c + 40.5f), 0, 255); /* offset -40 degC */
}

static void send_temperatures(const struct pack *p)
{
	uint8_t d[6];
	int t = pack_temp_max(p);

	for (int i = 0; i < PACK_TEMPS; i++) {
		d[i] = temp_byte(p->temp_c[i]);
	}
	d[4] = temp_byte(p->temp_c[t]);
	d[5] = t + 1;
	queue_frame(ID_TEMPERATURES, d, 6);
}

static void send_cell_voltages(const struct pack *p)
{
	/* Multiplexed: byte 0 is the group, then up to three cells. */
	for (int g = 0; g * 3 < PACK_CELLS; g++) {
		uint8_t d[8] = {g};
		int n = MIN(3, PACK_CELLS - g * 3);

		for (int k = 0; k < n; k++) {
			sys_put_le16(p->cell_mv[g * 3 + k], &d[1 + 2 * k]);
		}
		queue_frame(ID_CELL_VOLTS, d, 1 + 2 * n);
	}
}

static void send_heartbeat(uint32_t seq)
{
	uint8_t d[8];

	sys_put_le32(seq, &d[0]);
	sys_put_le32((uint32_t)(k_uptime_get() / 1000), &d[4]);
	queue_frame(ID_HEARTBEAT, d, 8);
}

static void send_fault(const struct pack *p, uint8_t trigger, uint8_t seq)
{
	uint8_t d[6] = {p->faults, trigger, p->fault_index + 1};

	sys_put_le16((uint16_t)p->fault_value, &d[3]);
	d[5] = seq;
	queue_frame(ID_FAULT, d, 6);
}

static void send_ack(uint8_t cmd, uint8_t token, uint8_t result, uint8_t state)
{
	uint8_t d[4] = {cmd, token, result, state};

	queue_frame(ID_COMMAND_ACK, d, 4);
}

/* ---- the watchdog ---- */

static void wdt_expired(int channel_id, void *user)
{
	/* Called from the task watchdog's timer (interrupt context). Switch
	 * logging to synchronous so this line gets out before the reset. */
	LOG_PANIC();
	LOG_ERR("task watchdog: thread '%s' (channel %d) stopped feeding, rebooting",
		k_thread_name_get((k_tid_t)user), channel_id);
	sys_reboot(SYS_REBOOT_COLD);
}

/* ---- threads ---- */

static void bms_thread(void *a, void *b, void *c)
{
	struct pack pack;
	uint32_t tick = 0, hb_seq = 0;
	uint8_t fault_seq = 0;
	int64_t edge_seen_ms = -EDGE_TIMEOUT_MS;
	enum bms_state last_state;
	int wdt = task_wdt_add(BMS_WDT_MS, wdt_expired, k_current_get());

	pack_init(&pack);
	last_state = pack.state;
	LOG_INF("pack: %d cells, SOC %d%%, state %s", PACK_CELLS, (int)(pack.soc * 100),
		pack_state_name(pack.state));

	for (;;) {
		struct bms_evt e;

		k_msgq_get(&evt_q, &e, K_FOREVER);
		task_wdt_feed(wdt);

		if (e.type == EVT_EDGE) {
			if (k_uptime_get() - edge_seen_ms > EDGE_TIMEOUT_MS) {
				LOG_INF("edge controller heartbeat seen (0x%03x)", ID_EDGE_HB);
			}
			edge_seen_ms = k_uptime_get();
			continue;
		}

		if (e.type == EVT_CMD) {
			if (e.cmd == CMD_SIM_HANG) {
				LOG_WRN("cmd 0x%02x SimHang: BMS thread stops for 5 s", e.cmd);
				send_ack(e.cmd, e.token, RESULT_OK, pack.state);
				k_sleep(K_SECONDS(5)); /* the task watchdog fires after 1 s */
				continue;
			}
			enum cmd_result r = pack_command(&pack, e.cmd);

			LOG_INF("cmd 0x%02x token %u -> %s, state %s", e.cmd, e.token,
				r == RESULT_OK ? "ok" : r == RESULT_REJECTED ? "rejected" : "unknown",
				pack_state_name(pack.state));
			send_ack(e.cmd, e.token, r, pack.state);
		} else { /* EVT_TICK */
			tick++;
			pack_step(&pack, TICK_MS / 1000.0f);

			if (pack.new_fault) {
				LOG_ERR("FAULT 0x%02x raised: index %u value %d, contactor opened",
					pack.new_fault, pack.fault_index + 1, pack.fault_value);
				send_fault(&pack, pack.new_fault, fault_seq++);
			} else if (pack.faults && tick % 10 == 0) {
				send_fault(&pack, 0, fault_seq++);
			}

			bool edge_alive = k_uptime_get() - edge_seen_ms < EDGE_TIMEOUT_MS;

			send_status(&pack, edge_alive, (uint8_t)tick);
			if (tick % 5 == 0) {
				send_cell_summary(&pack);
				send_temperatures(&pack);
			}
			if (tick % 10 == 0) {
				send_cell_voltages(&pack);
				send_heartbeat(hb_seq++);
			}
			if (tick % 100 == 0) {
				int lo, hi;

				pack_cell_min_max(&pack, &lo, &hi);
				LOG_INF("%s V=%u mV I=%d dA SOC=%d%% cells %u..%u mV Tmax=%d C "
					"edge=%d dropped evt/tx %ld/%ld",
					pack_state_name(pack.state), pack_voltage_mv(&pack),
					(int)(pack.current_a * 10), (int)(pack.soc * 100),
					pack.cell_mv[lo], pack.cell_mv[hi],
					(int)pack.temp_c[pack_temp_max(&pack)], edge_alive,
					atomic_get(&dropped_evts), atomic_get(&dropped_tx));
			}
		}

		if (pack.state != last_state) {
			LOG_INF("state %s -> %s", pack_state_name(last_state),
				pack_state_name(pack.state));
			last_state = pack.state;
		}
	}
}

static void can_tx_thread(void *a, void *b, void *c)
{
	int wdt = task_wdt_add(TX_WDT_MS, wdt_expired, k_current_get());
	uint32_t errors = 0;

	for (;;) {
		struct can_frame f;

		k_msgq_get(&tx_q, &f, K_FOREVER);
		int err = can_send(can_dev, &f, K_MSEC(100), NULL, NULL);

		if (err != 0 && (errors++ % 50) == 0) {
			LOG_WRN("can_send 0x%03x failed: %d (%u errors so far)", f.id, err, errors);
		}
		task_wdt_feed(wdt);
	}
}

K_THREAD_DEFINE(bms_tid, 2048, bms_thread, NULL, NULL, NULL, 5, 0, SYS_FOREVER_MS);
K_THREAD_DEFINE(can_tx_tid, 1024, can_tx_thread, NULL, NULL, NULL, 4, 0, SYS_FOREVER_MS);

/* ---- start-up ---- */

int main(void)
{
	int err;

	LOG_INF("zephyr-bms on %s, CAN ids 0x%03x-0x%03x", CONFIG_BOARD, ID_STATUS, ID_FAULT);

	if (!device_is_ready(can_dev)) {
		LOG_ERR("CAN device %s not ready", can_dev->name);
		return 0;
	}
	/* The edge controller's command, and its heartbeat (only to report
	 * EdgeAlive). Everything else on the bus is filtered out in hardware. */
	struct can_filter cmd_filter = {.id = ID_COMMAND, .mask = CAN_STD_ID_MASK};
	struct can_filter edge_filter = {.id = ID_EDGE_HB, .mask = CAN_STD_ID_MASK};

	if (can_add_rx_filter(can_dev, can_rx_cb, NULL, &cmd_filter) < 0 ||
	    can_add_rx_filter(can_dev, can_rx_cb, NULL, &edge_filter) < 0) {
		LOG_ERR("can_add_rx_filter failed");
		return 0;
	}
	can_set_state_change_callback(can_dev, can_state_cb, NULL);

	err = can_start(can_dev);
	if (err) {
		LOG_ERR("can_start: %d", err);
		return 0;
	}
	LOG_INF("CAN %s started", can_dev->name);

	/* The task watchdog multiplexes our two threads onto the one hardware
	 * watchdog: if any channel is not fed in time, its callback runs; if the
	 * task watchdog itself stops, the IWDG resets the chip. */
	err = task_wdt_init(hw_wdt);
	if (err) {
		LOG_ERR("task_wdt_init: %d", err);
		return 0;
	}
	LOG_INF("task watchdog on %s", hw_wdt ? hw_wdt->name : "(no hardware fallback)");

	k_thread_name_set(bms_tid, "bms");
	k_thread_name_set(can_tx_tid, "can_tx");
	k_thread_start(can_tx_tid);
	k_thread_start(bms_tid);
	k_timer_start(&tick_timer, K_MSEC(TICK_MS), K_MSEC(TICK_MS));
	return 0;
}
```

## src/pack.c
```c
/*
 * A deliberately simple pack model: good enough to make the numbers on the
 * bus move in believable ways, nothing more.
 *
 * - 8 cells in series, 5 Ah. Open-circuit voltage is linear in SOC
 *   (3.0 V empty, 4.1 V full), minus an I*R drop under load.
 * - With the contactor closed the pack is discharged at a constant 18.5 A
 *   (SOC falls ~0.1 %/s, so it visibly moves during a demo).
 * - Temperatures settle towards ambient + I^2 heating with a first-order lag.
 * - Cells start slightly unbalanced; balancing bleeds the high ones.
 * - The Sim* commands inject faults: a hot sensor or a cell drifting high.
 */
#include "pack.h"

#include <math.h>
#include <stddef.h>

#define CAPACITY_AH      5.0f
#define LOAD_CURRENT_A   18.5f
#define CELL_R_OHM       0.005f
#define AMBIENT_C        25.0f
#define TEMP_TAU_S       20.0f
#define HOT_SENSOR       1     /* sensor index heated by SimOverTemp */
#define HOT_TARGET_C     85.0f
#define HOT_TAU_S        8.0f
#define DRIFT_CELL       2     /* cell index pushed up by SimOverVoltage */
#define DRIFT_V_PER_S    0.025f
#define BLEED_V_PER_S    0.001f
#define BALANCE_WINDOW_V 0.005f

static const float initial_offset_v[PACK_CELLS] = {
	0.000f, 0.012f, -0.008f, 0.005f, 0.020f, -0.003f, 0.002f, -0.010f,
};

void pack_init(struct pack *p)
{
	*p = (struct pack){0};
	p->soc = 0.80f;
	for (int i = 0; i < PACK_CELLS; i++) {
		p->cell_offset_v[i] = initial_offset_v[i];
	}
	for (int i = 0; i < PACK_TEMPS; i++) {
		p->temp_c[i] = AMBIENT_C + 0.5f * i;
	}
	p->scenario = SCEN_NORMAL;
	p->state = BMS_INIT;
	pack_step(p, 0.0f);
	p->state = BMS_STANDBY; /* self-test "passed" */
}

static float approach(float value, float target, float tau_s, float dt)
{
	return value + (target - value) * (1.0f - expf(-dt / tau_s));
}

static void simulate(struct pack *p, float dt)
{
	p->current_a = p->contactor ? LOAD_CURRENT_A : 0.0f;

	p->soc -= p->current_a * dt / (3600.0f * CAPACITY_AH);
	if (p->soc < 0.0f) {
		p->soc = 0.0f;
	}

	/* Fault injection, and the way back when the scenario is cleared. */
	float *drift = &p->cell_offset_v[DRIFT_CELL];
	if (p->scenario == SCEN_OVER_VOLTAGE) {
		*drift += DRIFT_V_PER_S * dt;
	} else if (*drift > initial_offset_v[DRIFT_CELL]) {
		*drift -= DRIFT_V_PER_S * dt;
		if (*drift < initial_offset_v[DRIFT_CELL]) {
			*drift = initial_offset_v[DRIFT_CELL];
		}
	}

	float ocv = 3.0f + 1.1f * p->soc;
	float load_drop = p->current_a * CELL_R_OHM;
	for (int i = 0; i < PACK_CELLS; i++) {
		float v = ocv + p->cell_offset_v[i] - load_drop;
		p->cell_mv[i] = (uint16_t)lroundf(v * 1000.0f);
	}

	float heat_target = AMBIENT_C + 0.02f * p->current_a * p->current_a;
	for (int i = 0; i < PACK_TEMPS; i++) {
		bool hot = p->scenario == SCEN_OVER_TEMP && i == HOT_SENSOR;
		float target = hot ? HOT_TARGET_C : heat_target + 0.5f * i;
		p->temp_c[i] = approach(p->temp_c[i], target, hot ? HOT_TAU_S : TEMP_TAU_S, dt);
	}

	/* Passive balancing: bleed every cell more than 5 mV above the lowest. */
	p->balancing_mask = 0;
	if (p->balancing) {
		int lo, hi;
		pack_cell_min_max(p, &lo, &hi);
		for (int i = 0; i < PACK_CELLS; i++) {
			if (p->cell_mv[i] > p->cell_mv[lo] + BALANCE_WINDOW_V * 1000.0f) {
				p->cell_offset_v[i] -= BLEED_V_PER_S * dt;
				p->balancing_mask |= 1u << i;
			}
		}
	}
}

static void raise_fault(struct pack *p, uint8_t flag, int index, int value)
{
	if (p->faults & flag) {
		return; /* already latched */
	}
	p->faults |= flag;
	if (!p->new_fault) {
		p->new_fault = flag;
		p->fault_index = (uint8_t)index;
		p->fault_value = (int16_t)value;
	}
}

static void check_limits(struct pack *p)
{
	int lo, hi;
	pack_cell_min_max(p, &lo, &hi);
	int t = pack_temp_max(p);

	p->new_fault = 0;
	if (p->cell_mv[hi] > CELL_OV_TRIP_MV) {
		raise_fault(p, FAULT_OVER_VOLTAGE, hi, p->cell_mv[hi]);
	}
	if (p->cell_mv[lo] < CELL_UV_TRIP_MV) {
		raise_fault(p, FAULT_UNDER_VOLTAGE, lo, p->cell_mv[lo]);
	}
	if (p->temp_c[t] > TEMP_OT_TRIP_C) {
		raise_fault(p, FAULT_OVER_TEMP, t, (int)lroundf(p->temp_c[t] * 10.0f));
	}
	if (fabsf(p->current_a) > CURRENT_OC_TRIP_A) {
		raise_fault(p, FAULT_OVER_CURRENT, 0, (int)lroundf(p->current_a * 10.0f));
	}

	/* Any latched fault: open the contactor and stay in FAULT until reset. */
	if (p->faults && p->state != BMS_INIT) {
		p->state = BMS_FAULT;
		p->contactor = false;
		p->current_a = 0.0f;
	}
}

void pack_step(struct pack *p, float dt)
{
	simulate(p, dt);
	check_limits(p);
}

static bool conditions_clear(const struct pack *p)
{
	int lo, hi;
	pack_cell_min_max(p, &lo, &hi);
	return p->cell_mv[hi] < CELL_OV_CLEAR_MV && p->cell_mv[lo] > CELL_UV_CLEAR_MV &&
	       p->temp_c[pack_temp_max(p)] < TEMP_OT_CLEAR_C;
}

enum cmd_result pack_command(struct pack *p, uint8_t cmd)
{
	switch (cmd) {
	case CMD_CONTACTOR_CLOSE:
		if (p->state != BMS_STANDBY) {
			return p->state == BMS_ACTIVE ? RESULT_OK : RESULT_REJECTED;
		}
		p->contactor = true;
		p->state = BMS_ACTIVE;
		return RESULT_OK;
	case CMD_CONTACTOR_OPEN:
		p->contactor = false;
		if (p->state == BMS_ACTIVE) {
			p->state = BMS_STANDBY;
		}
		return RESULT_OK;
	case CMD_BALANCING_ON:
		if (p->state == BMS_FAULT) {
			return RESULT_REJECTED;
		}
		p->balancing = true;
		return RESULT_OK;
	case CMD_BALANCING_OFF:
		p->balancing = false;
		return RESULT_OK;
	case CMD_FAULT_RESET:
		if (p->state != BMS_FAULT) {
			return RESULT_OK;
		}
		if (!conditions_clear(p)) {
			return RESULT_REJECTED;
		}
		p->faults = 0;
		p->state = BMS_STANDBY;
		return RESULT_OK;
	case CMD_SIM_NORMAL:
		p->scenario = SCEN_NORMAL;
		return RESULT_OK;
	case CMD_SIM_OVER_TEMP:
		p->scenario = SCEN_OVER_TEMP;
		return RESULT_OK;
	case CMD_SIM_OVER_VOLTAGE:
		p->scenario = SCEN_OVER_VOLTAGE;
		return RESULT_OK;
	default:
		return RESULT_UNKNOWN;
	}
}

uint32_t pack_voltage_mv(const struct pack *p)
{
	uint32_t sum = 0;
	for (int i = 0; i < PACK_CELLS; i++) {
		sum += p->cell_mv[i];
	}
	return sum;
}

void pack_cell_min_max(const struct pack *p, int *min_i, int *max_i)
{
	*min_i = 0;
	*max_i = 0;
	for (int i = 1; i < PACK_CELLS; i++) {
		if (p->cell_mv[i] < p->cell_mv[*min_i]) {
			*min_i = i;
		}
		if (p->cell_mv[i] > p->cell_mv[*max_i]) {
			*max_i = i;
		}
	}
}

int pack_temp_max(const struct pack *p)
{
	int m = 0;
	for (int i = 1; i < PACK_TEMPS; i++) {
		if (p->temp_c[i] > p->temp_c[m]) {
			m = i;
		}
	}
	return m;
}

const char *pack_state_name(enum bms_state s)
{
	static const char *const names[] = {"INIT", "STANDBY", "ACTIVE", "FAULT"};
	return (unsigned)s < 4 ? names[s] : "?";
}
```

## src/pack.h
```c
/*
 * The simulated battery pack and the BMS state machine.
 *
 * Plain C with no Zephyr calls, so the logic can be read (and tested) on its
 * own. main.c is the Zephyr glue: threads, queue, timer, CAN, watchdog.
 */
#ifndef PACK_H
#define PACK_H

#include <stdbool.h>
#include <stdint.h>

#define PACK_CELLS 8
#define PACK_TEMPS 4

/* Fault flag bits, as in the BmsStatus.FaultFlags and BmsFault signals. */
#define FAULT_OVER_VOLTAGE  0x01
#define FAULT_UNDER_VOLTAGE 0x02
#define FAULT_OVER_TEMP     0x04
#define FAULT_OVER_CURRENT  0x08

/* Limits. A fault is raised above the trip value and may be reset only
 * once the value is back below the clear value (hysteresis). */
#define CELL_OV_TRIP_MV   4250
#define CELL_OV_CLEAR_MV  4200
#define CELL_UV_TRIP_MV   3000
#define CELL_UV_CLEAR_MV  3100
#define TEMP_OT_TRIP_C    60.0f
#define TEMP_OT_CLEAR_C   50.0f
#define CURRENT_OC_TRIP_A 100.0f

enum bms_state { BMS_INIT = 0, BMS_STANDBY = 1, BMS_ACTIVE = 2, BMS_FAULT = 3 };

/* BmsCommand.Cmd values */
enum bms_cmd {
	CMD_CONTACTOR_CLOSE = 0x01,
	CMD_CONTACTOR_OPEN = 0x02,
	CMD_BALANCING_ON = 0x03,
	CMD_BALANCING_OFF = 0x04,
	CMD_FAULT_RESET = 0x05,
	CMD_SIM_NORMAL = 0x10,
	CMD_SIM_OVER_TEMP = 0x11,
	CMD_SIM_OVER_VOLTAGE = 0x12,
	CMD_SIM_HANG = 0x7E, /* handled in main.c: stalls the BMS thread */
};

/* BmsCommandAck.Result values */
enum cmd_result { RESULT_OK = 0, RESULT_REJECTED = 1, RESULT_UNKNOWN = 2 };

enum scenario { SCEN_NORMAL, SCEN_OVER_TEMP, SCEN_OVER_VOLTAGE };

struct pack {
	/* physics */
	float soc;                       /* state of charge, 0..1 */
	float current_a;                 /* positive = discharging */
	float cell_offset_v[PACK_CELLS]; /* each cell's deviation from the average */
	float temp_c[PACK_TEMPS];
	enum scenario scenario;

	/* outputs of the last step */
	uint16_t cell_mv[PACK_CELLS];
	uint8_t balancing_mask;

	/* BMS */
	enum bms_state state;
	bool contactor;
	bool balancing;
	uint8_t faults;    /* latched fault flags */
	uint8_t new_fault; /* raised in the last step (one flag), else 0 */
	uint8_t fault_index;
	int16_t fault_value;
};

void pack_init(struct pack *p);

/* Advance the simulation by dt seconds, then check limits. */
void pack_step(struct pack *p, float dt);

/* Apply a command from the edge controller. */
enum cmd_result pack_command(struct pack *p, uint8_t cmd);

/* Derived values for the CAN frames */
uint32_t pack_voltage_mv(const struct pack *p);
void pack_cell_min_max(const struct pack *p, int *min_i, int *max_i);
int pack_temp_max(const struct pack *p);

const char *pack_state_name(enum bms_state s);

#endif
```
