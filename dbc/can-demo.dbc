VERSION "1"

NS_ :

BS_:

BU_: EDGE HOST

BO_ 256 EdgeHeartbeatVcan: 8 EDGE
 SG_ Seq : 0|32@1+ (1,0) [0|4294967295] "" HOST
 SG_ Magic : 32|32@1+ (1,0) [0|4294967295] "" HOST

BO_ 257 EdgeHeartbeat: 8 EDGE
 SG_ Seq : 0|32@1+ (1,0) [0|4294967295] "" HOST
 SG_ Magic : 32|32@1+ (1,0) [0|4294967295] "" HOST

BO_ 801 HostPing: 8 HOST
 SG_ Magic : 0|32@1+ (1,0) [0|4294967295] "" EDGE
 SG_ Count : 32|32@1+ (1,0) [0|4294967295] "" EDGE

CM_ BO_ 256 "can-demo heartbeat on the guest's vcan0 (never leaves the guest)";
CM_ BO_ 257 "can-demo heartbeat on guest can0, bridged to host vcan0. Seq counts up, Magic is ASCII HBT1";
CM_ BO_ 801 "Sent by scripts/host-can.py on the host: ASCII HOST + 32-bit counter";
CM_ SG_ 257 Seq "Heartbeat sequence number, little endian";
